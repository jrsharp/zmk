## app/boards/shields/chocv_hogp_test/Kconfig.defconfig
```kconfig
if SHIELD_CHOCV_HOGP_TEST

config ZMK_KEYBOARD_NAME
	default "ChocV HOGP Test"

endif
```

## app/boards/shields/chocv_hogp_test/Kconfig.shield
```kconfig
config SHIELD_CHOCV_HOGP_TEST
	def_bool $(shields_list_contains,chocv_hogp_test)
```

## app/boards/shields/corne_frst/Kconfig.defconfig
```kconfig
# Copyright (c) 2025 Jon Sharp
# Co-authored by Claude (Anthropic)
# SPDX-License-Identifier: MIT

if SHIELD_CORNE_FRST_LEFT

config ZMK_KEYBOARD_NAME
    default "FRST-M1KB"

config ZMK_SPLIT_ROLE_CENTRAL
    default y

endif

if SHIELD_CORNE_FRST_LEFT || SHIELD_CORNE_FRST_RIGHT

config ZMK_SPLIT
    default y

config ZMK_SPLIT_WIRED
    default y

endif
```

## app/boards/shields/corne_frst/Kconfig.shield
```kconfig
# Copyright (c) 2025 Jon Sharp
# Co-authored by Claude (Anthropic)
# SPDX-License-Identifier: MIT

config SHIELD_CORNE_FRST_LEFT
    def_bool $(shields_list_contains,corne_frst_left)

config SHIELD_CORNE_FRST_RIGHT
    def_bool $(shields_list_contains,corne_frst_right)
```

## app/boards/shields/frst36/Kconfig.shield
```kconfig
# Copyright (c) 2025 Jon Sharp
# Co-authored by Claude (Anthropic)
# SPDX-License-Identifier: MIT

config SHIELD_FRST36
    def_bool $(shields_list_contains,frst36)
```

## app/src/uart_9p_server/Kconfig
```kconfig
# Copyright (c) 2025 Jon Sharp
# Co-authored by Claude (Anthropic)
# SPDX-License-Identifier: MIT

menuconfig UART_9P_SERVER
    bool "9P Keyboard Server over UART"
    default n
    select NINEP
    select NINEP_SERVER
    select NINEP_TRANSPORT_UART
    select SERIAL
    select UART_INTERRUPT_DRIVEN
    select RING_BUFFER
    help
      Enable 9P filesystem server for keyboard input over UART.
      Exposes /kbd/kbin (keystrokes) and /kbd/leds (LED state).
      Used for wired keyboard connection to FRST terminal.

if UART_9P_SERVER

config UART_9P_DEVICE
    string "UART device for 9P server"
    default "uart0"
    help
      The UART device name to use for 9P communication.

config UART_9P_RX_BUF_SIZE
    int "UART RX buffer size"
    default 512
    help
      Size of the receive buffer for 9P messages.

config UART_9P_KEY_RING_SIZE
    int "Keystroke ring buffer size"
    default 64
    help
      Number of keystrokes to buffer before overflow.
      Each keystroke is 2 bytes (scancode + flags).

endif # UART_9P_SERVER
```

## app/src/uart_echo/Kconfig
```kconfig
# Copyright (c) 2025 Jon Sharp
# Co-authored by Claude (Anthropic)
# SPDX-License-Identifier: MIT

config UART_ECHO_TEST
    bool "UART Echo Test Module"
    default n
    select SERIAL
    select UART_INTERRUPT_DRIVEN
    help
      Simple UART echo test for verifying bidirectional communication.
      Echoes all received bytes back to the sender.
      Used for Phase 2 testing before implementing full 9P protocol.

config UART_ECHO_DEVICE
    string "UART device for echo test"
    default "uart0"
    depends on UART_ECHO_TEST
    help
      The UART device name to use for echo testing.
```

## app/west.yml
```yaml
manifest:
  remotes:
    - name: zephyrproject-rtos
      url-base: https://github.com/zephyrproject-rtos
    - name: zmkfirmware
      url-base: https://github.com/zmkfirmware
    - name: jrsharp
      url-base: https://github.com/jrsharp
    - name: memfault
      url-base: https://github.com/memfault
  projects:
    - name: zephyr
      remote: zmkfirmware
      revision: v3.5.0+zmk-fixes
      clone-depth: 1
      import:
        name-blocklist:
          - ci-tools
          - hal_altera
          - hal_cypress
          - hal_infineon
          - hal_microchip
          - hal_nxp
          - hal_openisa
          - hal_silabs
          - hal_xtensa
          - hal_st
          - hal_ti
          - loramac-node
          - net-tools
          - openthread
          - edtt
          - trusted-firmware-m
    - name: nanopb
      revision: 8c60555d6277a0360c876bd85d491fc4fb0cd74a
      path: modules/lib/nanopb
      remote: zmkfirmware
    - name: zmk-studio-messages
      revision: 6cb4c283e76209d59c45fbcb218800cd19e9339d
      path: modules/msgs/zmk-studio-messages
      remote: zmkfirmware
    - name: 9p4z
      path: modules/lib/9p4z
      remote: jrsharp
      revision: 71adac9d762e15320b34ebdfcbef97e974c0e617
    - name: memfault-firmware-sdk
      path: modules/lib/memfault-firmware-sdk
      revision: 1.30.3
      remote: memfault
  self:
    west-commands: scripts/west-commands.yml
```
